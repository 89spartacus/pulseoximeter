//Pulse Oximeter based on TSL230
//Copyright 2016 by Andreas Faulhaber

//Define Sensor (LED + PD)
int redLED = 8; int irLED = 9;
//TSL-OUT output
int TSL_Pin = 3;
//TSL input - sensor configuration (setupTSL)


//Operands for sensor data aquisition (TM=Time)
int readTM = 45; //sampling period of TSL (best signal @ 45ms through experimenting)
unsigned long currentTM,startTM,freq;
volatile unsigned long pulse_cnt;

//Operands for data processing
boolean ledState;//true=RED, false=IR
unsigned long Cnt,average,lastaverage,red,ir,lastred,lastir,Rmax,Rmin,IRmax,IRmin;
float rRed,rIR,HR,R,SpO,Heartrate,LastHeartrate;//values for calculation

//Display
#include "U8g2lib.h"
int printHR, printO2;boolean reDraw=true;
#define logo_width 128
#define logo_height 56
static unsigned const char logo[] U8X8_PROGMEM = { 0x00, 0xE0, 0x3F, 0x00, 0x00, 0xFC, 0x03, 0x00, 0x00, 0x00, 0x00, 0x00, 
  0x00, 0x00, 0x00, 0x00, 0x00, 0xFC, 0xFF, 0x01, 0x80, 0xFF, 0x1F, 0x00, 
  0x00, 0x00, 0x00, 0x00, 0x00, 0x00, 0x00, 0x00, 0x00, 0xFF, 0xFF, 0x03, 
  0xE0, 0xFF, 0x7F, 0x00, 0x00, 0x00, 0x00, 0x00, 0x00, 0x00, 0x00, 0x00, 
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  0x00, 0x00, 0x00, 0x00, 0x00, 0x00, 0x00, 0x00,};

U8G2_SSD1306_128X64_NONAME_1_SW_I2C u8g2(U8G2_R0,SCL,SDA,U8X8_PIN_NONE);

void setup(){
  pinMode(redLED, OUTPUT);  pinMode(irLED, OUTPUT);
  currentTM=0;startTM=0;pulse_cnt=0;Cnt=0;average=0;  
  R=0;Rmax=0;Rmin=10000;IRmax=0;IRmin=10000;
  ledSwitch(false);//turn on RED or IR according true or false
  //initialize the TSL digital read on PinX on interrupt
  attachInterrupt(digitalPinToInterrupt(TSL_Pin), add_pulse, RISING);
  //setupTSL();//function to call sensor configuration settings (sensitivity, frequency-divider)
  Serial.begin(9600);
  
  //draw welcoming logo
  u8g2.begin();
  u8g2.setFlipMode(0);
  u8g2.setColorIndex(1);//pixel on
    if(reDraw){u8g2.firstPage();
      while(u8g2.nextPage()){
        u8g2.drawXBMP( 0, 8, logo_width, logo_height, logo);}}
    reDraw=false;
    
    delay(2000);

}

void add_pulse() {//ISR adding a pulse count to every interrupt from sensor I/O
  pulse_cnt++;}
unsigned long readTSL(){//returns "freq" frequency/intensity from sensor reading  
  currentTM = millis();
  if((currentTM - startTM) >= readTM)// once reaching sampling period - save value & reset the ms counter
    {startTM = currentTM;
    freq = pulse_cnt * 2;
    pulse_cnt = 0;} 
  return(freq);}



void ledSwitch(bool ledState){ //color: RED=TRUE, IR=FALSE
  int Red_pin = HIGH;
  int IR_pin = LOW;
  if(ledState){//RED LED - ON
    Red_pin = HIGH;
    IR_pin = LOW;}
  else {    //IR LED - ON
    Red_pin = LOW;
    IR_pin = HIGH;}
  digitalWrite(redLED, Red_pin);
  digitalWrite(irLED, IR_pin);}

void loop(){
  //red measurement
  if(ledState){
    delay(45);
    red=readTSL();
    if(red>Rmax){Rmax=red;}
    else if(red<Rmin){Rmin=red;}
    ledState=!ledState;//switch to IR LED
    ledSwitch(ledState);}
  //IR measurement
  if(!ledState){
    delay(45);
    lastir=ir;//keep last ir for average-crossing comparison
    ir=readTSL();
    if(ir>IRmax){IRmax=ir;}
    else if(ir<IRmin){IRmin=ir;}
    Cnt++;//count the times the loop has ran (for HR measurement)
    if(IRmin!=10000){//calculate Average of Min & Max
      average=((IRmax + IRmin)/2);}
    ledState=!ledState;//switch to RED LED
    ledSwitch(ledState);}
  //Average-Crossing and calculations
  if((lastir>average)&&(ir<average)&&(Rmin<10000)&&(30<IRmax-IRmin)){
    HR = (1/(0.09*(float)Cnt) )*60;//heartrate in bpm (*60s) from measured frequency over t=0.09s times the counts (isrCnt) of average crossings of heartbeat
    if(40<HR&&HR<180){
      rRed=(float(Rmax-Rmin)/Rmin);//normalized Ratio of Red absorbance
      rIR=(float(IRmax-IRmin)/IRmin); //normalized Ratio of IR absorbance
      R=(rRed/rIR); //Ratio of ratios
      if(0.397<R&&R<1.5){
        SpO=108-20*R-0.375*R*R;} //SpO2 calculation currently based on literature
      else{SpO=99;}
      printO2=int(SpO);printHR=int(HR);
      //String HRSPO = int(HR)+String(" HR ")+int(SpO)+String("% SpO2"); //creating string for PC display
      //Serial.println(HRSPO);

      // picture loop
      u8g2.clear();
      u8g2.firstPage();  
      do {draw_header();draw_values();} while( u8g2.nextPage() );}
      
    delay(1);//delay for stabilisation
    Rmax=0;Rmin=10000;IRmax=0;IRmin=10000;average=0;Cnt=0;lastir=0;SpO=0;HR=0;//resetting variables
  }

      
  ///hard-reset if finger was temporarily removed loop continues and wont run into HR-check 
}

void draw_header() {
  u8g2.setFont(u8g2_font_unifont_t_latin);
  u8g2.setFontPosTop();
  u8g2.drawStr( 0, 0, "HR[bpm]");
  int w=u8g2.getStrWidth("SpO2[%]");
  u8g2.drawStr(128-w,0,"SpO2[%]");
  u8g2.drawHLine(0,15,128);}
void draw_values(){
  u8g2.setFont(u8g2_font_fur30_tn);
  u8g2.setFontPosBottom();
  u8g2.setCursor(0,64);
  u8g2.print(printHR);
  u8g2.setCursor(85,64);
  u8g2.print(printO2);}

